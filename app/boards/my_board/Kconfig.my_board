## app/boards/my_board/Kconfig.my_board
```kconfig
config BOARD_MY_BOARD
    select SOC_ESP32_WROVER_E_N4R8
    select SOC_ESP32_PROCPU if BOARD_MY_BOARD
    ##select SOC_ESP32_APPCPU if BOARD_MY_BOARD_ESP32_APPCPU
```

## app/boards/my_board/board.yml
```yaml
board:
  name: my_board
  full_name: My Board from Scratch
  vendor: Chrisesis
  socs: 
  - name: esp32
  
```

## app/boards/our_board/board.yml
```yaml
board:
  name: our_board
  full_name: Our Board
  vendor: Chrisesis
  socs:
  - name: esp32
```

## twister-out/native_sim_native/host/homework.unit.ring_buf/Kconfig/Kconfig.modules
```kconfig
menu "cmsis_6 (/home/vboxuser/demo/deps/modules/hal/cmsis_6)"
osource "$(ZEPHYR_CMSIS_6_KCONFIG)"
config ZEPHYR_CMSIS_6_MODULE
	bool
	default y
endmenu
menu "hal_espressif (/home/vboxuser/demo/deps/modules/hal/espressif)"
osource "/home/vboxuser/demo/deps/modules/hal/espressif/zephyr/Kconfig"
config ZEPHYR_HAL_ESPRESSIF_MODULE
	bool
	default y

config ZEPHYR_HAL_ESPRESSIF_MODULE_BLOBS
	bool
endmenu
menu "hal_nordic (/home/vboxuser/demo/deps/modules/hal/nordic)"
osource "$(ZEPHYR_HAL_NORDIC_KCONFIG)"
config ZEPHYR_HAL_NORDIC_MODULE
	bool
	default y

config ZEPHYR_HAL_NORDIC_MODULE_BLOBS
	bool
endmenu
menu "hal_nxp (/home/vboxuser/demo/deps/modules/hal/nxp)"
osource "$(ZEPHYR_HAL_NXP_KCONFIG)"
config ZEPHYR_HAL_NXP_MODULE
	bool
	default y

config ZEPHYR_HAL_NXP_MODULE_BLOBS
	bool
endmenu
config ZEPHYR_HAL_STM32_MODULE
	bool
	default y

config ZEPHYR_HAL_STM32_MODULE_BLOBS
	bool
```

## twister-out/native_sim_native/host/homework.unit.ring_buf/Kconfig/arch/Kconfig
```kconfig
# Load Zephyr Arch Kconfig descriptions.
osource "/home/vboxuser/demo/deps/zephyr/arch/rx/Kconfig"
osource "/home/vboxuser/demo/deps/zephyr/arch/x86/Kconfig"
osource "/home/vboxuser/demo/deps/zephyr/arch/xtensa/Kconfig"
osource "/home/vboxuser/demo/deps/zephyr/arch/sparc/Kconfig"
osource "/home/vboxuser/demo/deps/zephyr/arch/riscv/Kconfig"
osource "/home/vboxuser/demo/deps/zephyr/arch/posix/Kconfig"
osource "/home/vboxuser/demo/deps/zephyr/arch/mips/Kconfig"
osource "/home/vboxuser/demo/deps/zephyr/arch/arm64/Kconfig"
osource "/home/vboxuser/demo/deps/zephyr/arch/arm/Kconfig"
osource "/home/vboxuser/demo/deps/zephyr/arch/arc/Kconfig"
```

## twister-out/native_sim_native/host/homework.unit.ring_buf/Kconfig/boards/Kconfig
```kconfig
# Load Zephyr board Kconfig descriptions.
osource "/home/vboxuser/demo/deps/zephyr/boards/native/native_sim/Kconfig"
```

## twister-out/native_sim_native/host/homework.unit.ring_buf/Kconfig/boards/Kconfig.defconfig
```kconfig
# Load Zephyr board defconfig descriptions.
osource "/home/vboxuser/demo/deps/zephyr/boards/native/native_sim/Kconfig.defconfig"
```

## twister-out/native_sim_native/host/homework.unit.ring_buf/Kconfig/boards/Kconfig.native_sim
```kconfig
# Load board Kconfig descriptions.
osource "/home/vboxuser/demo/deps/zephyr/boards/native/native_sim/Kconfig.native_sim"
```
